## Kconfig
```kconfig
mainmenu "Libnova2 Configuration"

config LIBNOVA2_VERSION
    string
    option env="PROJECT_VERSION"
    default "2.0.0"

menu "Modules"
    source "src/Kconfig"
endmenu
```

## src/Kconfig
```kconfig
menu "Solar System (Planets & Major Bodies)"

config LIBNOVA2_SUN
    bool "Sun"
    default y
    help
      Enable Solar ephemeris calculations (solar.c).

      Provides functions to calculate the Sun's geocentric position
      (geometric and apparent), distance, and angular diameter.

      This module is fundamental for many other calculations, including
      Rise/Set times, Twilight, and Heliocentric corrections.

config LIBNOVA2_MERCURY
    bool "Mercury"
    default y
    select LIBNOVA2_VSOP87
    help
      Enable Mercury ephemeris calculations (mercury.c).

      Calculates Heliocentric coordinates using the VSOP87 theory.

config LIBNOVA2_VENUS
    bool "Venus"
    default y
    select LIBNOVA2_VSOP87
    help
      Enable Venus ephemeris calculations (venus.c).

      Calculates Heliocentric coordinates using the VSOP87 theory.

config LIBNOVA2_EARTH
    bool "Earth"
    default y
    select LIBNOVA2_VSOP87
    help
      Enable Earth ephemeris calculations (earth.c).

      Calculates Earth's Heliocentric coordinates using the VSOP87 theory.
      Fundamental for transforming Heliocentric to Geocentric coordinates
      for other planets.

config LIBNOVA2_MARS
    bool "Mars"
    default y
    select LIBNOVA2_VSOP87
    help
      Enable Mars ephemeris calculations (mars.c).

      Calculates Heliocentric coordinates using the VSOP87 theory.

config LIBNOVA2_JUPITER
    bool "Jupiter"
    default y
    select LIBNOVA2_VSOP87
    help
      Enable Jupiter ephemeris calculations (jupiter.c).

      Calculates Heliocentric coordinates using the VSOP87 theory.

config LIBNOVA2_SATURN
    bool "Saturn"
    default y
    select LIBNOVA2_VSOP87
    help
      Enable Saturn ephemeris calculations (saturn.c).

      Calculates Heliocentric coordinates using the VSOP87 theory.

config LIBNOVA2_URANUS
    bool "Uranus"
    default y
    select LIBNOVA2_VSOP87
    help
      Enable Uranus ephemeris calculations (uranus.c).

      Calculates Heliocentric coordinates using the VSOP87 theory.

config LIBNOVA2_NEPTUNE
    bool "Neptune"
    default y
    select LIBNOVA2_VSOP87
    help
      Enable Neptune ephemeris calculations (neptune.c).

      Calculates Heliocentric coordinates using the VSOP87 theory.

config LIBNOVA2_PLUTO
    bool "Pluto"
    default y
    help
      Enable Pluto ephemeris calculations (pluto.c).

      Calculates Pluto's Heliocentric coordinates. Note that Pluto's orbit
      is more eccentric and inclined than major planets.

config LIBNOVA2_MOON
    bool "Moon"
    default y
    help
      Enable Lunar ephemeris calculations (lunar.c).

      Includes the full ELP82 (Ephemeride Lunaire Parisienne) theory
      for high-precision lunar coordinates. Required for any moon-related
      calculations (Phase, Eclipses, etc.).

config LIBNOVA2_VSOP87
    bool "VSOP87 Theory"
    default y
    help
      Enable VSOP87 planetary theory implementation (vsop87.c).

      Variations Séculaires des Orbites Planétaires (VSOP) is a semi-analytic
      theory for the orbits of the planets. It provides high precision
      (better than 1 arcsecond) for Mercury through Neptune.

      This is selected automatically by any enabled planet.

endmenu

menu "Minor Bodies"

config LIBNOVA2_ASTEROID
    bool "Asteroids"
    default y
    help
      Enable Asteroid orbit calculations (asteroid.c).

      Provides functions to calculate the semi-major axis, mean motion,
      and other orbital elements for asteroids.

config LIBNOVA2_COMET
    bool "Comets"
    default y
    help
      Enable Comet orbit calculations (comet.c).

      Calculates cometary orbits, including parabolic and elliptical
      trajectories.

endmenu

menu "Time & Calendars"

config LIBNOVA2_JULIAN_DAY
    bool "Julian Day"
    default y
    help
      Enable Julian Day conversions (julian_day.c).

      The Julian Day (JD) is the continuous count of days since the beginning
      of the Julian Period (January 1, 4713 BC). It is the fundamental time
      variable for almost all astronomical calculations in this library.

config LIBNOVA2_DYNAMICAL_TIME
    bool "Dynamical Time"
    default y
    select LIBNOVA2_JULIAN_DAY
    help
      Enable Dynamical Time (TD) calculations (dynamical_time.c).

      Dynamical Time is the uniform time scale used in planetary theories/ephemerides.
      This module calculates the difference (Delta T) between Universal Time (UT)
      and Dynamical Time (TD).

config LIBNOVA2_SIDEREAL_TIME
    bool "Sidereal Time"
    default y
    select LIBNOVA2_JULIAN_DAY
    help
      Enable Sidereal Time calculations (sidereal_time.c).

      Sidereal time is the time scale that is based on the Earth's rate of
      rotation measured relative to the fixed stars. Essential for coordinate
      transformations (Equatorial <-> Horizontal).

config LIBNOVA2_HELIOCENTRIC_TIME
    bool "Heliocentric Time"
    default y
    select LIBNOVA2_JULIAN_DAY
    help
      Enable Heliocentric Time corrections (heliocentric_time.c).

      Calculates the time correction due to the time it takes for light
      to travel from the Sun to the Earth (light-time correction).

endmenu

menu "Motion & Orbits"

config LIBNOVA2_ELLIPTIC_MOTION
    bool "Elliptic Motion"
    default y
    help
      Enable Elliptic Motion calculations (elliptic_motion.c).

      Calculates the position of a body in an elliptical orbit (eccentricity < 1).
      Used for Planets and most Asteroids.

config LIBNOVA2_PARABOLIC_MOTION
    bool "Parabolic Motion"
    default y
    help
      Enable Parabolic Motion calculations (parabolic_motion.c).

      Calculates the position of a body in a parabolic orbit (eccentricity = 1).
      Commonly used for many Comets.

config LIBNOVA2_HYPERBOLIC_MOTION
    bool "Hyperbolic Motion"
    default y
    help
      Enable Hyperbolic Motion calculations (hyperbolic_motion.c).

      Calculates the position of a body in a hyperbolic orbit (eccentricity > 1).
      Used for non-periodic comets or interstellar objects.

config LIBNOVA2_PROPER_MOTION
    bool "Proper Motion"
    default y
    help
      Enable Proper Motion calculations (proper_motion.c).

      Proper motion is the continuous change in the positions of stars
      due to their own motion through space. This module corrects catalog
      coordinates for this effect.

endmenu

menu "Astrometry & Coordinates"

config LIBNOVA2_TRANSFORM
    bool "Coordinate Transformations"
    default y
    help
      Enable Coordinate Transformations (transform.c).

      Provides functions to convert between different coordinate systems:
      - Equatorial (RA/Dec) <-> Ecliptic (Long/Lat)
      - Equatorial <-> Horizontal (Alt/Az)
      - Equatorial <-> Galactic

config LIBNOVA2_NUTATION
    bool "Nutation"
    default y
    help
      Enable Nutation calculations (nutation.c).

      Nutation is the periodic oscillation of the Earth's axis (wobble).
      This implementation uses the IAU 1980 Theory of Nutation (63 terms).
      Precise astrometry requires checking this.

config LIBNOVA2_ABERRATION
    bool "Aberration"
    default y
    help
      Enable Aberration calculations (aberration.c).

      Aberration is the apparent displacement of a heavenly body due to
      the finite speed of light and the Earth's orbital motion.

config LIBNOVA2_APPARENT_POSITION
    bool "Apparent Position"
    default y
    select LIBNOVA2_NUTATION
    select LIBNOVA2_ABERRATION
    help
      Enable Apparent Position calculations (apparent_position.c).

      Calculates the position of a body as seen from Earth, correcting for
      light-time, aberration, nutation, and precession. This is what you
      actually see in the sky.

config LIBNOVA2_PRECESSION
    bool "Precession"
    default y
    help
      Enable Precession calculations (precession.c).

      Calculates the effect of the gradual shift in the orientation of
      Earth's axis of rotation (precession of the equinoxes).

config LIBNOVA2_REFRACTION
    bool "Refraction"
    default y
    help
      Enable Atmospheric Refraction calculations (refraction.c).

      Corrects altitude for the bending of light by the Earth's atmosphere.
      Important for objects near the horizon.

config LIBNOVA2_RISE_SET
    bool "Rise & Set"
    default y
    select LIBNOVA2_SIDEREAL_TIME
    help
      Enable Rise, Set, and Transit calculations (rise_set.c).

      Calculates the times when an object rises above, sets below, or
      transits (crosses the meridian of) the local horizon.

config LIBNOVA2_PARALLAX
    bool "Parallax"
    default y
    help
      Enable Parallax calculations (parallax.c).

      Corrects coordinates for the difference in perspective between the
      Earth's center (geocentric) and the observer's location (topocentric).
      Crucial for nearby objects (Moon, Planets).

config LIBNOVA2_ANGULAR_SEPARATION
    bool "Angular Separation"
    default y
    help
      Enable Angular Separation calculations (angular_separation.c).

      Calculates the angular distance between two objects on the celestial sphere.

config LIBNOVA2_AIRMASS
    bool "Airmass"
    default y
    help
      Enable Airmass calculations (airmass.c).

      Calculates the optical path length through Earth's atmosphere.
      Used for extinction corrections in photometry.
      
config LIBNOVA2_CONSTELLATION
    bool "Constellations"
    default y
    help
      Enable Constellation identification (constellation.c).

      Determines which constellation a given coordinate point lies within.

endmenu

menu "Utilities"

config LIBNOVA2_UTILITY
    bool "Utility Functions"
    default y
    help
      Enable general utility functions (utility.c).

      Includes helper functions for:
      - Angle normalization (0-360, 0-2PI)
      - Date/Time conversions (formatting)
      - Degree/Radian conversions
      - String formatting (DMS, HMS)

endmenu
```
